#include "ctap.h"
#include "cbor.h"
#include "sha256.h"
#include "storage.h"
#include "config.h"

#include <Arduino.h>
#include <string.h>
#if !FAKE_CRYPTO
#include <uECC.h>
#endif

void (*ctap_keepalive)(void) = NULL;

static const uint8_t AAGUID[16] PROGMEM = {
  0x6c, 0x4e, 0x6f, 0x2d, 0x4c, 0x42, 0x21, 0x00,
  0x41, 0x72, 0x64, 0x75, 0x69, 0x6e, 0x6f, 0x31
};

#if FAKE_CRYPTO
// Generated by the snippet in the README: a genuine secp256r1 point, so the
// browser's COSE parsing and point-on-curve check succeed, plus a structurally
// valid ASN.1 DER signature. Neither is secret and neither means anything.
static const uint8_t FAKE_PUBKEY[64] PROGMEM = {
  0xC9, 0xFA, 0xB8, 0x1C, 0x91, 0x88, 0x6B, 0xB0, 0x89, 0xB6, 0xA2, 0xF3,
  0x3E, 0x08, 0xAA, 0xBE, 0x4D, 0xC8, 0x4F, 0x36, 0x91, 0x55, 0x67, 0xD3,
  0xC3, 0xAB, 0x3A, 0xC2, 0x08, 0x10, 0x65, 0xDC, 0x1A, 0x00, 0x92, 0x8F,
  0xF6, 0x69, 0xD9, 0x61, 0x0E, 0x13, 0xA2, 0x1E, 0xC2, 0x5F, 0xA1, 0xDD,
  0x34, 0xB7, 0xEB, 0x78, 0xAE, 0xB8, 0x4C, 0x0E, 0xD4, 0x25, 0x82, 0xC8,
  0x36, 0x16, 0x61, 0x3C,
};
static const uint8_t FAKE_SIG[] PROGMEM = {
  0x30, 0x45, 0x02, 0x21, 0x00, 0xA2, 0xA8, 0xD0, 0xD0, 0x5C, 0xC9, 0xCA,
  0xB1, 0x51, 0x0E, 0xB4, 0xC8, 0x52, 0x72, 0xC1, 0xDD, 0xD9, 0xB1, 0x63,
  0x91, 0xB0, 0xA0, 0xC1, 0x32, 0x74, 0x91, 0x19, 0x65, 0xEE, 0x6B, 0x9B,
  0xD3, 0x02, 0x20, 0x0D, 0x48, 0x23, 0xB5, 0x88, 0x8F, 0x24, 0x3A, 0x21,
  0x54, 0xC7, 0x50, 0x38, 0xCE, 0x2F, 0x12, 0xC6, 0xD9, 0x7B, 0x90, 0xC3,
  0x5C, 0xA6, 0x7C, 0x64, 0xB9, 0x3F, 0x11, 0x20, 0x23, 0xAB, 0x8D,
};
#endif

#if !FAKE_CRYPTO
// P-256 group order, big-endian.
static const uint8_t P256_N[32] PROGMEM = {
  0xFF,0xFF,0xFF,0xFF,0x00,0x00,0x00,0x00,0xFF,0xFF,0xFF,0xFF,0xFF,0xFF,0xFF,0xFF,
  0xBC,0xE6,0xFA,0xAD,0xA7,0x17,0x9E,0x84,0xF3,0xB9,0xCA,0xC2,0xFC,0x63,0x25,0x51
};
#endif

#define CRED_ID_LEN   (CRED_NONCE_LEN + 32)   // nonce || HMAC tag = 48
#define COSE_KEY_LEN  77
#define AUTHDATA_MC_LEN (32 + 1 + 4 + 16 + 2 + CRED_ID_LEN + COSE_KEY_LEN)  // 180
#define AUTHDATA_GA_LEN (32 + 1 + 4)                                        // 37

#define FLAG_UP 0x01
#define FLAG_UV 0x04
#define FLAG_AT 0x40

// Key-derivation domain separators.
#define KD_PRIV  'k'
#define KD_CRED  'c'
#define KD_BLOB  'L'
#define KD_NONCE 'n'

// --------------------------------------------------------------- helpers ---

static void kdf(uint8_t tag, const uint8_t rpIdHash[32],
                const uint8_t nonce[CRED_NONCE_LEN], uint8_t iter, uint8_t out[32])
{
  uint8_t master[32];
  hmac_sha256_ctx h;

  store_master(master);
  hmac_sha256_init(&h, master, 32);
  memset(master, 0, sizeof(master));

  hmac_sha256_update(&h, &tag, 1);
  hmac_sha256_update(&h, rpIdHash, 32);
  hmac_sha256_update(&h, nonce, CRED_NONCE_LEN);
  hmac_sha256_update(&h, &iter, 1);
  hmac_sha256_final(&h, out);
}

#if !FAKE_CRYPTO
// 0 < k < n
static bool priv_valid(const uint8_t k[32])
{
  uint8_t i, nz = 0;
  for (i = 0; i < 32; i++) nz |= k[i];
  if (!nz) return false;
  for (i = 0; i < 32; i++) {
    uint8_t n = pgm_read_byte(&P256_N[i]);
    if (k[i] < n) return true;
    if (k[i] > n) return false;
  }
  return false;
}

// Deterministic: same (rpIdHash, nonce) always yields the same private key, so
// nothing per-credential has to be stored.
static bool derive_priv(const uint8_t rpIdHash[32],
                        const uint8_t nonce[CRED_NONCE_LEN], uint8_t priv[32])
{
  for (uint8_t iter = 0; iter < 8; iter++) {
    kdf(KD_PRIV, rpIdHash, nonce, iter, priv);
    if (priv_valid(priv)) return true;
  }
  return false;
}
#endif  // !FAKE_CRYPTO

static void make_cred_id(const uint8_t rpIdHash[32],
                         const uint8_t nonce[CRED_NONCE_LEN], uint8_t out[CRED_ID_LEN])
{
  memcpy(out, nonce, CRED_NONCE_LEN);
  kdf(KD_CRED, rpIdHash, nonce, 0, out + CRED_NONCE_LEN);
}

static bool check_cred_id(const uint8_t rpIdHash[32],
                          const uint8_t *credId, uint32_t credIdLen)
{
  if (credIdLen != CRED_ID_LEN) return false;
  uint8_t tag[32], diff = 0;
  kdf(KD_CRED, rpIdHash, credId, 0, tag);
  for (uint8_t i = 0; i < 32; i++) diff |= tag[i] ^ credId[CRED_NONCE_LEN + i];
  return diff == 0;
}

static void fresh_nonce(uint32_t counter, const uint8_t rpIdHash[32],
                        uint8_t nonce[CRED_NONCE_LEN])
{
  uint8_t master[32], full[32];
  hmac_sha256_ctx h;
  uint8_t c[4] = { (uint8_t)counter, (uint8_t)(counter >> 8),
                   (uint8_t)(counter >> 16), (uint8_t)(counter >> 24) };
  uint8_t tag = KD_NONCE;

  store_master(master);
  hmac_sha256_init(&h, master, 32);
  memset(master, 0, sizeof(master));
  hmac_sha256_update(&h, &tag, 1);
  hmac_sha256_update(&h, rpIdHash, 32);
  hmac_sha256_update(&h, c, 4);
  hmac_sha256_final(&h, full);
  memcpy(nonce, full, CRED_NONCE_LEN);
}

// --------------------------------------------------------- micro-ecc glue ---
#if !FAKE_CRYPTO
//
// ECDSA nonce generation. micro-ecc offers uECC_sign_deterministic() (RFC 6979)
// but it wants a hash context plus a 128-byte scratch buffer, ~250 bytes of
// stack at the exact moment the P-256 scalar multiply is already ~800 deep.
// We cannot afford that.
//
// Instead we keep uECC_sign() and make its RNG deterministic: k is drawn from
// HMAC-SHA256(masterSecret, "s" || messageHash || signCount). That gives the
// same property RFC 6979 exists to provide -- a nonce that is unpredictable to
// an attacker and never repeats for two different messages -- without the
// scratch space, and without trusting the board's very poor entropy sources.
// Reusing k across two signatures leaks the private key, so this must never
// fall back to analogRead() noise.
static uint8_t detSeed[32];
static uint8_t detCtr;

// noinline: the HMAC context is 176 bytes and is only needed *before* the
// scalar multiply starts. Inlined, it would inflate ecdsa_sign's frame for the
// entire duration of the signature.
static __attribute__((noinline))
void det_seed(const uint8_t priv[32], const uint8_t digest[32], uint32_t counter)
{
  uint8_t master[32];
  hmac_sha256_ctx h;
  uint8_t tag = 's';
  uint8_t c[4] = { (uint8_t)counter, (uint8_t)(counter >> 8),
                   (uint8_t)(counter >> 16), (uint8_t)(counter >> 24) };

  store_master(master);
  hmac_sha256_init(&h, master, 32);
  memset(master, 0, sizeof(master));
  hmac_sha256_update(&h, &tag, 1);
  hmac_sha256_update(&h, priv, 32);   // binds k to the signing key, so a rolled
                                      // back counter cannot repeat a nonce for
                                      // a different credential
  hmac_sha256_update(&h, digest, 32);
  hmac_sha256_update(&h, c, 4);
  hmac_sha256_final(&h, detSeed);
  detCtr = 0;
}

static int det_rng(uint8_t *dest, unsigned size)
{
  // micro-ecc may ask more than once if the first candidate k is out of range,
  // so the counter must keep advancing.
  while (size) {
    uint8_t blk[32];
    hmac_sha256(detSeed, 32, &detCtr, 1, blk);
    detCtr++;
    unsigned n = size < 32 ? size : 32;
    memcpy(dest, blk, n);
    dest += n;
    size -= n;
  }
  return 1;
}

// r||s (64 bytes) -> ASN.1 DER SEQUENCE. Returns DER length (<= 72).
// noinline: its 72-byte scratch must not be merged into a caller frame that is
// live while the P-256 scalar multiply is running.
static __attribute__((noinline))
uint8_t sig_to_der(const uint8_t raw[64], uint8_t *out)
{
  uint8_t tmp[72];
  uint8_t p = 0;

  for (uint8_t half = 0; half < 2; half++) {
    const uint8_t *v = raw + half * 32;
    uint8_t i = 0;
    while (i < 31 && v[i] == 0) i++;          // strip leading zeros
    uint8_t len = 32 - i;
    uint8_t pad = (v[i] & 0x80) ? 1 : 0;      // keep it positive
    tmp[p++] = 0x02;
    tmp[p++] = (uint8_t)(len + pad);
    if (pad) tmp[p++] = 0x00;
    memcpy(tmp + p, v + i, len);
    p += len;
  }

  out[0] = 0x30;
  out[1] = p;
  memcpy(out + 2, tmp, p);
  return (uint8_t)(p + 2);
}

// ~1.5-2 s at 16 MHz -- almost entirely the P-256 scalar multiply. Emits
// keepalives so the host doesn't abandon the transaction.
static __attribute__((noinline))
bool ecdsa_sign(const uint8_t priv[32], const uint8_t hash[32],
                uint32_t counter, uint8_t *der, uint8_t *derLen)
{
  uint8_t raw[64];

  det_seed(priv, hash, counter);
  if (ctap_keepalive) ctap_keepalive();
  if (!uECC_sign(priv, hash, 32, raw, uECC_secp256r1())) return false;
  if (ctap_keepalive) ctap_keepalive();

  *derLen = sig_to_der(raw, der);
  return true;
}

#endif  // !FAKE_CRYPTO

// ---------------------------------------------------------- user presence ---

static bool user_presence(void)
{
#if REQUIRE_BUTTON
  uint32_t start = millis();
  LED_ON();
  while (millis() - start < UP_TIMEOUT_MS) {
    if (BTN_PRESSED()) {
      LED_OFF();
      delay(50);                              // crude debounce
      return true;
    }
    if (ctap_keepalive) ctap_keepalive();
    delay(20);
  }
  LED_OFF();
  return false;
#else
  // No button wired: presence is asserted automatically. This makes the device
  // silently usable by anything that can talk to the USB port -- fine for a
  // test rig, not acceptable for a real security key.
  LED_ON();
  delay(30);
  LED_OFF();
  return true;
#endif
}

// ------------------------------------------------------------- authData ----

static void put_authdata_header(CborOut *o, const uint8_t rpIdHash[32],
                                uint8_t flags, uint32_t counter)
{
  uint8_t hdr[37];
  memcpy(hdr, rpIdHash, 32);
  hdr[32] = flags;
  hdr[33] = (uint8_t)(counter >> 24);
  hdr[34] = (uint8_t)(counter >> 16);
  hdr[35] = (uint8_t)(counter >> 8);
  hdr[36] = (uint8_t)counter;
  cbor_raw(o, hdr, 37);
}

// --------------------------------------------------------- authenticator ---

static uint16_t do_get_info(uint8_t *resp)
{
  CborOut o;
  uint8_t aaguid[16];

  memcpy_P(aaguid, AAGUID, 16);
  cbor_out_init(&o, resp + 1, CTAP_MAX_MSG - 1);

#if ENABLE_LARGEBLOB
  cbor_map(&o, 6);
#else
  cbor_map(&o, 4);                           // no extensions, no blob limit
#endif

  cbor_uint(&o, 0x01);                       // versions
  cbor_array(&o, 1);
  cbor_tstr_P(&o, PSTR("FIDO_2_1"));         // largeBlobs is a 2.1 feature; we
                                             // do not claim FIDO_2_0 because we
                                             // implement none of the PIN
                                             // machinery a 2.0 client expects.

#if ENABLE_LARGEBLOB
  cbor_uint(&o, 0x02);                       // extensions
  cbor_array(&o, 1);
  cbor_tstr_P(&o, PSTR("largeBlobKey"));
#endif

  cbor_uint(&o, 0x03);                       // aaguid
  cbor_bstr(&o, aaguid, 16);

  cbor_uint(&o, 0x04);                       // options
#if ENABLE_LARGEBLOB
  cbor_map(&o, 3);
#else
  cbor_map(&o, 2);
#endif
  cbor_tstr_P(&o, PSTR("rk"));         cbor_bool(&o, true);
  cbor_tstr_P(&o, PSTR("up"));         cbor_bool(&o, true);
#if ENABLE_LARGEBLOB
  cbor_tstr_P(&o, PSTR("largeBlobs")); cbor_bool(&o, true);
#endif
  // No "clientPin"/"uv" keys at all: this authenticator has no user
  // verification, which is what lets largeBlobs run without a pinUvAuthToken.

  cbor_uint(&o, 0x05);                       // maxMsgSize
  cbor_uint(&o, CTAP_MAX_MSG);

#if ENABLE_LARGEBLOB
  cbor_uint(&o, 0x0B);                       // maxSerializedLargeBlobArray
  cbor_uint(&o, LARGE_BLOB_MAX);
#endif

  if (o.err) { resp[0] = CTAP1_ERR_OTHER; return 1; }
  resp[0] = CTAP2_OK;
  return (uint16_t)(1 + o.len);
}

static uint16_t do_make_credential(CborIn *in, uint8_t *resp)
{
  const uint8_t *clientDataHash = NULL;
  const char *rpId = NULL;   uint32_t rpIdLen = 0;
  const uint8_t *userId = NULL; uint32_t userIdLen = 0;
  bool es256 = false, wantLargeBlobKey = false, rk = false;
  uint32_t nkeys;

  if (!cbor_enter_map(in, &nkeys)) return (resp[0] = CTAP2_ERR_INVALID_CBOR), 1;

  while (nkeys--) {
    uint32_t key;
    if (!cbor_get_uint(in, &key)) return (resp[0] = CTAP2_ERR_INVALID_CBOR), 1;
    switch (key) {
      case 0x01: {
        uint32_t n;
        if (!cbor_get_bytes(in, &clientDataHash, &n) || n != 32)
          return (resp[0] = CTAP1_ERR_INVALID_PARAMETER), 1;
        break;
      }
      case 0x02: {                                   // rp
        uint32_t m;
        if (!cbor_enter_map(in, &m)) return (resp[0] = CTAP2_ERR_INVALID_CBOR), 1;
        while (m--) {
          if (cbor_text_is(in, "id")) {
            if (!cbor_get_text(in, &rpId, &rpIdLen))
              return (resp[0] = CTAP2_ERR_INVALID_CBOR), 1;
          } else {
            if (!cbor_skip(in) || !cbor_skip(in))
              return (resp[0] = CTAP2_ERR_INVALID_CBOR), 1;
          }
        }
        break;
      }
      case 0x03: {                                   // user
        uint32_t m;
        if (!cbor_enter_map(in, &m)) return (resp[0] = CTAP2_ERR_INVALID_CBOR), 1;
        while (m--) {
          if (cbor_text_is(in, "id")) {
            if (!cbor_get_bytes(in, &userId, &userIdLen))
              return (resp[0] = CTAP2_ERR_INVALID_CBOR), 1;
          } else {
            if (!cbor_skip(in) || !cbor_skip(in))
              return (resp[0] = CTAP2_ERR_INVALID_CBOR), 1;
          }
        }
        break;
      }
      case 0x04: {                                   // pubKeyCredParams
        uint32_t n;
        if (!cbor_enter_array(in, &n)) return (resp[0] = CTAP2_ERR_INVALID_CBOR), 1;
        while (n--) {
          uint32_t m;
          if (!cbor_enter_map(in, &m)) return (resp[0] = CTAP2_ERR_INVALID_CBOR), 1;
          while (m--) {
            if (cbor_text_is(in, "alg")) {
              int32_t alg;
              if (!cbor_get_int(in, &alg)) return (resp[0] = CTAP2_ERR_INVALID_CBOR), 1;
              if (alg == -7) es256 = true;            // ES256, the only one we do
            } else {
              if (!cbor_skip(in) || !cbor_skip(in))
                return (resp[0] = CTAP2_ERR_INVALID_CBOR), 1;
            }
          }
        }
        break;
      }
      case 0x06: {                                   // extensions
        uint32_t m;
        if (!cbor_enter_map(in, &m)) return (resp[0] = CTAP2_ERR_INVALID_CBOR), 1;
        while (m--) {
          if (ENABLE_LARGEBLOB && cbor_text_is(in, "largeBlobKey")) {
            if (!cbor_get_bool(in, &wantLargeBlobKey))
              return (resp[0] = CTAP2_ERR_INVALID_CBOR), 1;
          } else {
            if (!cbor_skip(in) || !cbor_skip(in))
              return (resp[0] = CTAP2_ERR_INVALID_CBOR), 1;
          }
        }
        break;
      }
      case 0x07: {                                   // options
        uint32_t m;
        if (!cbor_enter_map(in, &m)) return (resp[0] = CTAP2_ERR_INVALID_CBOR), 1;
        while (m--) {
          if (cbor_text_is(in, "rk")) {
            if (!cbor_get_bool(in, &rk)) return (resp[0] = CTAP2_ERR_INVALID_CBOR), 1;
          } else if (cbor_text_is(in, "uv")) {
            bool uv;
            if (!cbor_get_bool(in, &uv)) return (resp[0] = CTAP2_ERR_INVALID_CBOR), 1;
            if (uv) return (resp[0] = CTAP2_ERR_UNSUPPORTED_OPTION), 1;
          } else {
            if (!cbor_skip(in) || !cbor_skip(in))
              return (resp[0] = CTAP2_ERR_INVALID_CBOR), 1;
          }
        }
        break;
      }
      case 0x08:                                     // pinUvAuthParam
        return (resp[0] = CTAP2_ERR_PIN_AUTH_INVALID), 1;
      case 0x05:                                     // excludeList: ignored
      default:
        if (!cbor_skip(in)) return (resp[0] = CTAP2_ERR_INVALID_CBOR), 1;
        break;
    }
  }

  if (!clientDataHash || !rpId) return (resp[0] = CTAP2_ERR_MISSING_PARAMETER), 1;
  if (!es256)                   return (resp[0] = CTAP2_ERR_UNSUPPORTED_ALGORITHM), 1;
  if (userIdLen > MAX_USER_ID_LEN) return (resp[0] = CTAP1_ERR_INVALID_LENGTH), 1;
  // CTAP2.1 6.1: the largeBlobKey extension is only defined for discoverable
  // credentials, because the blob has to be findable without an allowList.
  if (wantLargeBlobKey && !rk) return (resp[0] = CTAP2_ERR_INVALID_OPTION), 1;
  if (!user_presence())         return (resp[0] = CTAP2_ERR_OPERATION_DENIED), 1;

  uint8_t rpIdHash[32];
  sha256((const uint8_t *)rpId, rpIdLen, rpIdHash);

  uint32_t counter = store_next_counter();

  uint8_t nonce[CRED_NONCE_LEN];
  fresh_nonce(counter, rpIdHash, nonce);

  uint8_t pub[64];
#if FAKE_CRYPTO
  memcpy_P(pub, FAKE_PUBKEY, sizeof(pub));   // ~0 ms instead of ~4.7 s
#else
  uint8_t priv[32];
  if (!derive_priv(rpIdHash, nonce, priv)) return (resp[0] = CTAP1_ERR_OTHER), 1;
  if (ctap_keepalive) ctap_keepalive();
  if (!uECC_compute_public_key(priv, pub, uECC_secp256r1())) {
    memset(priv, 0, sizeof(priv));
    return (resp[0] = CTAP1_ERR_OTHER), 1;
  }
  memset(priv, 0, sizeof(priv));
  if (ctap_keepalive) ctap_keepalive();
#endif

  uint8_t credId[CRED_ID_LEN];
  make_cred_id(rpIdHash, nonce, credId);

  // We keep exactly one discoverable-credential slot. Overwriting it is the
  // documented behaviour here; a second rk registration evicts the first.
  if (rk) store_rk_put(rpIdHash, nonce, userId, (uint8_t)userIdLen);

#if ENABLE_TYPEOUT
  // user.id is the one field a web page can put arbitrary bytes into that
  // reaches the authenticator untouched -- the client neither hashes nor
  // encrypts it. That makes it the write channel for the type-out text, so a
  // browser alone can set what the button types.
  if (rk) store_text_chunk(userId, (uint16_t)userIdLen);
#endif

  uint8_t aaguid[16];
  memcpy_P(aaguid, AAGUID, 16);

  CborOut o;
  cbor_out_init(&o, resp + 1, CTAP_MAX_MSG - 1);

  cbor_map(&o, wantLargeBlobKey ? 4 : 3);

  cbor_uint(&o, 0x01);
  cbor_tstr_P(&o, PSTR("none"));                    // "none" attestation: no
                                                    // batch cert, no extra sig.
  cbor_uint(&o, 0x02);
  cbor_head_out(&o, CBOR_BSTR, AUTHDATA_MC_LEN);
  put_authdata_header(&o, rpIdHash, FLAG_UP | FLAG_AT, counter);
  cbor_raw(&o, aaguid, 16);
  {
    uint8_t l[2] = { (uint8_t)(CRED_ID_LEN >> 8), (uint8_t)CRED_ID_LEN };
    cbor_raw(&o, l, 2);
  }
  cbor_raw(&o, credId, CRED_ID_LEN);
  {
    // COSE_Key: {1: 2 (EC2), 3: -7 (ES256), -1: 1 (P-256), -2: x, -3: y}
    static const uint8_t coseHdr[] PROGMEM = {
      0xA5, 0x01, 0x02, 0x03, 0x26, 0x20, 0x01, 0x21, 0x58, 0x20
    };
    uint8_t h[sizeof(coseHdr)];
    memcpy_P(h, coseHdr, sizeof(coseHdr));
    cbor_raw(&o, h, sizeof(h));
    cbor_raw(&o, pub, 32);
    uint8_t y[3] = { 0x22, 0x58, 0x20 };
    cbor_raw(&o, y, 3);
    cbor_raw(&o, pub + 32, 32);
  }

  cbor_uint(&o, 0x03);
  cbor_map(&o, 0);                                  // empty attStmt

  if (wantLargeBlobKey) {
    uint8_t lbk[32];
    kdf(KD_BLOB, rpIdHash, nonce, 0, lbk);
    cbor_uint(&o, 0x05);           // CTAP2.1 6.1.2: largeBlobKey. NOT 0x0B --
                                   // that is getInfo's maxSerializedLargeBlobArray.
    cbor_bstr(&o, lbk, 32);
    memset(lbk, 0, sizeof(lbk));
  }

  if (o.err) return (resp[0] = CTAP1_ERR_OTHER), 1;
  resp[0] = CTAP2_OK;
  return (uint16_t)(1 + o.len);
}

// Serializes the assertion response. Kept in its own frame (noinline) because
// its ~150 bytes of buffers -- credential ID, user handle, largeBlobKey --
// would otherwise sit on the stack throughout the P-256 scalar multiply, which
// is already the deepest point in the firmware.
static __attribute__((noinline))
uint16_t ga_emit(uint8_t *resp, const uint8_t rpIdHash[32],
                 const uint8_t nonce[CRED_NONCE_LEN],
                 const uint8_t *authData, const uint8_t *der, uint8_t derLen,
                 bool fromRk, bool wantLargeBlobKey)
{
  uint8_t credId[CRED_ID_LEN];
  CborOut o;

  make_cred_id(rpIdHash, nonce, credId);
  cbor_out_init(&o, resp + 1, CTAP_MAX_MSG - 1);

  uint8_t nOut = 3;
  if (fromRk) nOut++;
  if (wantLargeBlobKey) nOut++;
  cbor_map(&o, nOut);

  cbor_uint(&o, 0x01);                       // credential descriptor
  cbor_map(&o, 2);
  cbor_tstr_P(&o, PSTR("id"));   cbor_bstr(&o, credId, CRED_ID_LEN);
  cbor_tstr_P(&o, PSTR("type")); cbor_tstr_P(&o, PSTR("public-key"));

  cbor_uint(&o, 0x02);                       // authData
  cbor_bstr(&o, authData, AUTHDATA_GA_LEN);

  cbor_uint(&o, 0x03);                       // signature
  cbor_bstr(&o, der, derLen);

  if (fromRk) {
    uint8_t userId[MAX_USER_ID_LEN];
    uint8_t userIdLen = store_rk_userid(userId);
    cbor_uint(&o, 0x04);                     // user handle
    cbor_map(&o, 1);
    cbor_tstr_P(&o, PSTR("id"));
    cbor_bstr(&o, userId, userIdLen);
  }

  if (wantLargeBlobKey) {
    uint8_t lbk[32];
    kdf(KD_BLOB, rpIdHash, nonce, 0, lbk);
    cbor_uint(&o, 0x07);
    cbor_bstr(&o, lbk, 32);
    memset(lbk, 0, sizeof(lbk));
  }

  if (o.err) return (resp[0] = CTAP1_ERR_OTHER), 1;
  resp[0] = CTAP2_OK;
  return (uint16_t)(1 + o.len);
}

static uint16_t do_get_assertion(CborIn *in, uint8_t *resp)
{
  const uint8_t *clientDataHash = NULL;
  const char *rpId = NULL; uint32_t rpIdLen = 0;
  bool wantLargeBlobKey = false, up = true;
  bool haveCred = false, fromRk = false;
  uint8_t nonce[CRED_NONCE_LEN];
  uint8_t rpIdHash[32];
  uint32_t nkeys;

  if (!cbor_enter_map(in, &nkeys)) return (resp[0] = CTAP2_ERR_INVALID_CBOR), 1;

  // allowList entries are verified as they are parsed rather than collected
  // into a fixed-size array. That removes both the arbitrary length cap and
  // ~24 bytes of stack. It relies on CTAP2's canonical map ordering putting
  // rpId (key 1) ahead of allowList (key 3), which is checked below.
  bool haveRpIdHash = false;
  bool haveAllowList = false;

  while (nkeys--) {
    uint32_t key;
    if (!cbor_get_uint(in, &key)) return (resp[0] = CTAP2_ERR_INVALID_CBOR), 1;
    switch (key) {
      case 0x01:
        if (!cbor_get_text(in, &rpId, &rpIdLen))
          return (resp[0] = CTAP2_ERR_INVALID_CBOR), 1;
        sha256((const uint8_t *)rpId, rpIdLen, rpIdHash);
        haveRpIdHash = true;
        break;
      case 0x02: {
        uint32_t n;
        if (!cbor_get_bytes(in, &clientDataHash, &n) || n != 32)
          return (resp[0] = CTAP1_ERR_INVALID_PARAMETER), 1;
        break;
      }
      case 0x03: {                                   // allowList
        uint32_t n;
        if (!cbor_enter_array(in, &n)) return (resp[0] = CTAP2_ERR_INVALID_CBOR), 1;
        // Non-canonical ordering would leave rpIdHash unknown here.
        if (!haveRpIdHash) return (resp[0] = CTAP2_ERR_INVALID_CBOR), 1;
        haveAllowList = true;
        while (n--) {
          uint32_t m;
          if (!cbor_enter_map(in, &m)) return (resp[0] = CTAP2_ERR_INVALID_CBOR), 1;
          while (m--) {
            if (cbor_text_is(in, "id")) {
              const uint8_t *d; uint32_t dl;
              if (!cbor_get_bytes(in, &d, &dl))
                return (resp[0] = CTAP2_ERR_INVALID_CBOR), 1;
              if (!haveCred && check_cred_id(rpIdHash, d, dl)) {
                memcpy(nonce, d, CRED_NONCE_LEN);
                haveCred = true;
              }
            } else {
              if (!cbor_skip(in) || !cbor_skip(in))
                return (resp[0] = CTAP2_ERR_INVALID_CBOR), 1;
            }
          }
        }
        break;
      }
      case 0x04: {                                   // extensions
        uint32_t m;
        if (!cbor_enter_map(in, &m)) return (resp[0] = CTAP2_ERR_INVALID_CBOR), 1;
        while (m--) {
          if (ENABLE_LARGEBLOB && cbor_text_is(in, "largeBlobKey")) {
            if (!cbor_get_bool(in, &wantLargeBlobKey))
              return (resp[0] = CTAP2_ERR_INVALID_CBOR), 1;
          } else {
            if (!cbor_skip(in) || !cbor_skip(in))
              return (resp[0] = CTAP2_ERR_INVALID_CBOR), 1;
          }
        }
        break;
      }
      case 0x05: {                                   // options
        uint32_t m;
        if (!cbor_enter_map(in, &m)) return (resp[0] = CTAP2_ERR_INVALID_CBOR), 1;
        while (m--) {
          if (cbor_text_is(in, "up")) {
            if (!cbor_get_bool(in, &up)) return (resp[0] = CTAP2_ERR_INVALID_CBOR), 1;
          } else if (cbor_text_is(in, "uv")) {
            bool uv;
            if (!cbor_get_bool(in, &uv)) return (resp[0] = CTAP2_ERR_INVALID_CBOR), 1;
            if (uv) return (resp[0] = CTAP2_ERR_UNSUPPORTED_OPTION), 1;
          } else {
            if (!cbor_skip(in) || !cbor_skip(in))
              return (resp[0] = CTAP2_ERR_INVALID_CBOR), 1;
          }
        }
        break;
      }
      case 0x06:                                     // pinUvAuthParam
        return (resp[0] = CTAP2_ERR_PIN_AUTH_INVALID), 1;
      default:
        if (!cbor_skip(in)) return (resp[0] = CTAP2_ERR_INVALID_CBOR), 1;
        break;
    }
  }

  if (!clientDataHash || !haveRpIdHash) return (resp[0] = CTAP2_ERR_MISSING_PARAMETER), 1;

  // No allowList => the platform wants a discoverable credential.
  if (!haveCred && !haveAllowList && store_rk_match(rpIdHash)) {
    store_rk_nonce(nonce);
    haveCred = true;
    fromRk = true;
  }
  if (!haveCred) return (resp[0] = CTAP2_ERR_NO_CREDENTIALS), 1;

  if (up && !user_presence()) return (resp[0] = CTAP2_ERR_OPERATION_DENIED), 1;

  uint32_t counter = store_next_counter();

  // Sign over authenticatorData || clientDataHash.
  uint8_t authData[AUTHDATA_GA_LEN];
  memcpy(authData, rpIdHash, 32);
  authData[32] = up ? FLAG_UP : 0x00;
  authData[33] = (uint8_t)(counter >> 24);
  authData[34] = (uint8_t)(counter >> 16);
  authData[35] = (uint8_t)(counter >> 8);
  authData[36] = (uint8_t)counter;

  uint8_t digest[32];
  {
    sha256_ctx c;
    sha256_init(&c);
    sha256_update(&c, authData, AUTHDATA_GA_LEN);
    sha256_update(&c, clientDataHash, 32);
    sha256_final(&c, digest);
  }

  uint8_t der[72], derLen;
#if FAKE_CRYPTO
  (void)digest;
  derLen = (uint8_t)sizeof(FAKE_SIG);
  memcpy_P(der, FAKE_SIG, derLen);
#else
  uint8_t priv[32];
  if (!derive_priv(rpIdHash, nonce, priv)) return (resp[0] = CTAP1_ERR_OTHER), 1;
  bool ok = ecdsa_sign(priv, digest, counter, der, &derLen);
  memset(priv, 0, sizeof(priv));
  if (!ok) return (resp[0] = CTAP1_ERR_OTHER), 1;
#endif

  // From here on `resp` may be overwriting the request buffer, but everything
  // still needed lives in locals.
  return ga_emit(resp, rpIdHash, nonce, authData, der, derLen,
                 fromRk, wantLargeBlobKey);
}

// ----------------------------------------------------- authenticatorLargeBlobs
#if ENABLE_LARGEBLOB

// A `set` is streamed straight into EEPROM as fragments arrive (there is no
// room to stage 512 bytes in SRAM). The SHA-256 checksum is accumulated on the
// fly. Because the bytes hit EEPROM before they are verified, the committed
// length is zeroed for the duration of the transaction and only restored once
// the checksum matches; any abort rolls the array back to empty.
static bool       lbInProgress = false;
static uint32_t   lbCid        = 0;   // channel that owns the transaction
static uint16_t   lbExpected   = 0;
static uint16_t   lbGot        = 0;
static sha256_ctx lbHash;
static uint8_t    lbTail[16];

// Ends a transaction that has already been committed (or never started).
static void lb_done(void)
{
  lbInProgress = false;
  lbExpected = lbGot = 0;
  lbCid = 0;
}

// Ends a transaction that did NOT complete. EEPROM may hold a partial array
// while the committed length says otherwise, so the array must be reset.
void ctap_large_blob_cancel(void)
{
  if (!lbInProgress) return;
  lb_done();
  store_blob_reset();
}

static uint32_t ctapChannel = 0;

void ctap_set_channel(uint32_t cid) { ctapChannel = cid; }

static uint16_t do_large_blobs(CborIn *in, uint8_t *resp)
{
  uint32_t getCount = 0, offset = 0, length = 0;
  const uint8_t *setData = NULL;
  uint32_t setLen = 0;
  bool haveGet = false, haveSet = false, haveOffset = false, haveLength = false;
  uint32_t nkeys;

  if (!cbor_enter_map(in, &nkeys)) return (resp[0] = CTAP2_ERR_INVALID_CBOR), 1;

  while (nkeys--) {
    uint32_t key;
    if (!cbor_get_uint(in, &key)) return (resp[0] = CTAP2_ERR_INVALID_CBOR), 1;
    switch (key) {
      case 0x01:
        if (!cbor_get_uint(in, &getCount)) return (resp[0] = CTAP2_ERR_INVALID_CBOR), 1;
        haveGet = true;
        break;
      case 0x02:
        if (!cbor_get_bytes(in, &setData, &setLen)) return (resp[0] = CTAP2_ERR_INVALID_CBOR), 1;
        haveSet = true;
        break;
      case 0x03:
        if (!cbor_get_uint(in, &offset)) return (resp[0] = CTAP2_ERR_INVALID_CBOR), 1;
        haveOffset = true;
        break;
      case 0x04:
        if (!cbor_get_uint(in, &length)) return (resp[0] = CTAP2_ERR_INVALID_CBOR), 1;
        haveLength = true;
        break;
      case 0x05:                                     // pinUvAuthParam
      case 0x06:                                     // pinUvAuthProtocol
        // We advertise no UV of any kind, so per CTAP2.1 the platform must not
        // send these. Reject rather than silently ignore.
        return (resp[0] = CTAP2_ERR_PIN_AUTH_INVALID), 1;
      default:
        if (!cbor_skip(in)) return (resp[0] = CTAP2_ERR_INVALID_CBOR), 1;
        break;
    }
  }

  if (haveGet == haveSet) return (resp[0] = CTAP1_ERR_INVALID_PARAMETER), 1;
  if (!haveOffset)        return (resp[0] = CTAP2_ERR_MISSING_PARAMETER), 1;

  // ------------------------------------------------------------------ get --
  if (haveGet) {
    if (haveLength) return (resp[0] = CTAP1_ERR_INVALID_PARAMETER), 1;
    ctap_large_blob_cancel();      // a read abandons any half-written array

    uint16_t stored = store_blob_len();
    if (offset > stored) return (resp[0] = CTAP1_ERR_INVALID_PARAMETER), 1;

    uint32_t avail = stored - offset;
    uint32_t n = getCount < avail ? getCount : avail;
    if (n > CTAP_MAX_MSG - 8) n = CTAP_MAX_MSG - 8;

    CborOut o;
    cbor_out_init(&o, resp + 1, CTAP_MAX_MSG - 1);
    cbor_map(&o, 1);
    cbor_uint(&o, 0x01);
    cbor_head_out(&o, CBOR_BSTR, n);
    if (o.err || o.len + n > o.cap) return (resp[0] = CTAP1_ERR_OTHER), 1;
    store_blob_read((uint16_t)offset, o.buf + o.len, (uint16_t)n);
    o.len += n;

    resp[0] = CTAP2_OK;
    return (uint16_t)(1 + o.len);
  }

  // ------------------------------------------------------------------ set --
  if (offset == 0) {
    if (!haveLength) return (resp[0] = CTAP2_ERR_MISSING_PARAMETER), 1;
    // 17 = shortest legal array: CBOR `[]` plus the 16-byte checksum.
    if (length < 17) return (resp[0] = CTAP1_ERR_INVALID_PARAMETER), 1;
    if (length > LARGE_BLOB_MAX) return (resp[0] = CTAP2_ERR_LARGE_BLOB_STORAGE_FULL), 1;
    ctap_large_blob_cancel();      // discard any previous partial transaction
    lbInProgress = true;
    lbCid = ctapChannel;
    lbExpected = (uint16_t)length;
    lbGot = 0;
    sha256_init(&lbHash);
    // Mark the stored array invalid for the duration: fragments are written
    // straight to EEPROM, so until the checksum verifies there is no coherent
    // array to hand out.
    store_blob_commit_len(0);
  } else {
    if (haveLength)      return (resp[0] = CTAP1_ERR_INVALID_PARAMETER), 1;
    if (!lbInProgress)   return (resp[0] = CTAP2_ERR_NOT_ALLOWED), 1;
    // Without this, a second channel could splice its own data into another
    // channel's in-flight array and still produce a valid checksum.
    if (lbCid != ctapChannel) return (resp[0] = CTAP2_ERR_NOT_ALLOWED), 1;
    if (offset != lbGot)  return (resp[0] = CTAP1_ERR_INVALID_PARAMETER), 1;
  }

  if (lbGot + setLen > lbExpected) {
    ctap_large_blob_cancel();
    return (resp[0] = CTAP1_ERR_INVALID_PARAMETER), 1;
  }

  store_blob_write(lbGot, setData, (uint16_t)setLen);

  // Everything except the trailing 16 checksum bytes feeds the digest.
  uint16_t bodyEnd = lbExpected - 16;
  for (uint32_t i = 0; i < setLen; i++) {
    uint16_t abs = lbGot + (uint16_t)i;
    if (abs < bodyEnd) sha256_update(&lbHash, setData + i, 1);
    else               lbTail[abs - bodyEnd] = setData[i];
  }
  lbGot += (uint16_t)setLen;

  if (lbGot < lbExpected) {                 // more fragments to come
    resp[0] = CTAP2_OK;
    return 1;
  }

  uint8_t digest[32], diff = 0;
  uint16_t total = lbExpected;      // lb_done() clears lbExpected; keep a copy
  sha256_final(&lbHash, digest);
  for (uint8_t i = 0; i < 16; i++) diff |= digest[i] ^ lbTail[i];
  lb_done();

  if (diff) {
    // EEPROM already holds the rejected bytes, so fall back to the empty array
    // rather than leaving a half-written one behind.
    store_blob_reset();
    return (resp[0] = CTAP2_ERR_INTEGRITY_FAILURE), 1;
  }

  store_blob_commit_len(total);
  resp[0] = CTAP2_OK;
  return 1;
}

#else   // !ENABLE_LARGEBLOB

void ctap_large_blob_cancel(void) {}
static uint32_t ctapChannel = 0;
void ctap_set_channel(uint32_t cid) { ctapChannel = cid; (void)ctapChannel; }

#endif
// -----------------------------------------------------------------------------

void ctap_init(void)
{
#if !FAKE_CRYPTO
  uECC_set_rng(&det_rng);
#endif
  store_init();
}

uint16_t ctap_handle(const uint8_t *req, uint16_t reqLen, uint8_t *resp)
{
  if (reqLen < 1) { resp[0] = CTAP1_ERR_INVALID_LENGTH; return 1; }

  uint8_t cmd = req[0];
  CborIn in;
  cbor_in_init(&in, req + 1, reqLen - 1);

  switch (cmd) {
    case CTAP_GET_INFO:
      return do_get_info(resp);
    case CTAP_MAKE_CREDENTIAL:
      return do_make_credential(&in, resp);
    case CTAP_GET_ASSERTION:
      return do_get_assertion(&in, resp);
#if ENABLE_LARGEBLOB
    case CTAP_LARGE_BLOBS:
      return do_large_blobs(&in, resp);
#endif
    case CTAP_RESET:
      if (!user_presence()) { resp[0] = CTAP2_ERR_OPERATION_DENIED; return 1; }
      store_reset();
      resp[0] = CTAP2_OK;
      return 1;
    case CTAP_GET_NEXT_ASSERT:
      resp[0] = CTAP2_ERR_NOT_ALLOWED;
      return 1;
    case CTAP_CLIENT_PIN:
      resp[0] = CTAP2_ERR_UNSUPPORTED_OPTION;
      return 1;
    default:
      resp[0] = CTAP1_ERR_INVALID_COMMAND;
      return 1;
  }
}
